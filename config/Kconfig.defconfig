## config/boards/shields/4by4/west.yml
```yaml
manifest:
  remotes:
    - name: zmkfirmware
      url-base: https://github.com/zmkfirmware
    - name: HypnotisedLemon
      url-base: https://github.com/HypnotisedLemon/zmk-config
  projects:
    - name: zmk
      remote: zmkfirmware
      revision: main
      import: app/west.yml
  self:
    path: config
```

## config/west.yml
```yaml
manifest:
  remotes:
    - name: zmkfirmware
      url-base: https://github.com/zmkfirmware
  projects:
    - name: zmk
      remote: zmkfirmware
      revision: https://github.com/zmkfirmware/zmk
      import: config/west.yml
  self:
    path: config
```
